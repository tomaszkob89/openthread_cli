## CMakeLists.txt
```
#
# Copyright (c) 2021 Nordic Semiconductor ASA
#
# SPDX-License-Identifier: LicenseRef-Nordic-5-Clause
#
cmake_minimum_required(VERSION 3.20.0)

find_package(Zephyr REQUIRED HINTS $ENV{ZEPHYR_BASE})

project(openthread_cli)

# NORDIC SDK APP START
target_sources(app PRIVATE src/main.c)
# NORDIC SDK APP END
```

## Kconfig
```
#
# Copyright (c) 2021 Nordic Semiconductor ASA
#
# SPDX-License-Identifier: LicenseRef-Nordic-5-Clause
#

menu "Zephyr Kernel"
source "Kconfig.zephyr"
endmenu

module = OT_COMMAND_LINE_INTERFACE
module-str = ot_cli
source "${ZEPHYR_BASE}/subsys/logging/Kconfig.template.log_config"
```

## prj.conf
```kconfig
#
# Copyright (c) 2021 Nordic Semiconductor
#
# SPDX-License-Identifier: LicenseRef-Nordic-5-Clause
#

CONFIG_ASSERT=y
CONFIG_NETWORKING=y
CONFIG_NET_L2_OPENTHREAD=y
CONFIG_OPENTHREAD_PING_SENDER=y
CONFIG_OPENTHREAD_MANUAL_START=y

CONFIG_NEWLIB_LIBC=y

CONFIG_SHELL=y
CONFIG_SHELL_ARGC_MAX=26
CONFIG_SHELL_PROMPT_UART=""
CONFIG_SHELL_VT100_COLORS=n
CONFIG_SHELL_CMD_BUFF_SIZE=1024
CONFIG_SHELL_DEFAULT_TERMINAL_WIDTH=1024

CONFIG_MAIN_STACK_SIZE=2048

CONFIG_NUM_METAIRQ_PRIORITIES=1
```

## overlay-logging.conf
```kconfig
#
# Copyright (c) 2021 Nordic Semiconductor
#
# SPDX-License-Identifier: LicenseRef-Nordic-5-Clause

CONFIG_LOG=y
CONFIG_LOG_STRDUP_BUF_COUNT=26
CONFIG_LOG_STRDUP_MAX_STRING=128

# CONFIG_OPENTHREAD_DEBUG=y
# CONFIG_OPENTHREAD_LOG_LEVEL_INFO=y
CONFIG_IEEE802154_DRIVER_LOG_LEVEL_DBG=y
```

## boards/nrf54fpga_nrf5440_cpuapp.conf
```kconfig
CONFIG_NRF_802154_RADIO_DRIVER=n
CONFIG_NRF_802154_SER_HOST=y
CONFIG_OPENAMP_SLAVE=n
CONFIG_ENTROPY_GENERATOR=y
CONFIG_NRFX_RNG=n
CONFIG_RPMSG_SERVICE_NUM_ENDPOINTS=2

CONFIG_NRF_802154_ENCRYPTION=n

CONFIG_SHELL_BACKEND_SERIAL=y
CONFIG_SHELL_BACKEND_SERIAL_INTERRUPT_DRIVEN=y
CONFIG_UART_NRFX=y
CONFIG_UART_136_ENHANCED_POLL_OUT=n
CONFIG_UART_CONSOLE=y
CONFIG_CONSOLE=y

CONFIG_IPM_NRFX_BELLBOARD=y
CONFIG_IPM_NRFX_BELLBOARD0=y
CONFIG_IPM_NRFX_BELLBOARD0_TARGET=1

CONFIG_NRF_802154_SOURCE_INTERNAL=y

CONFIG_HEAP_MEM_POOL_SIZE=4096


CONFIG_TEST_RANDOM_GENERATOR=y

CONFIG_MPU_STACK_GUARD=y

CONFIG_OPENTHREAD_RADIO_WORKQUEUE_STACK_SIZE=1084
CONFIG_FLASH=n
```

## boards/nrf54fpga_nrf5440_cpuapp.overlay
```dts
/*
 * Copyright (c) 2021 Nordic Semiconductor ASA
 *
 * SPDX-License-Identifier: Apache-2.0
 */

/ {
	chosen {
		zephyr,ipc_shm = &gram00;
		zephyr,ipc = &bellboard0;
		zephyr,console = &uart136;
		zephyr,shell-uart = &uart136;
		zephyr,sram = &gram01;
	};
};

&uart136 {
	status = "okay";
	current-speed = <19200>;
};

&bellboard0 {
	status = "okay";
};
```

## src/main.c
```c
/*
 * Copyright (c) 2020 Nordic Semiconductor ASA
 *
 * SPDX-License-Identifier: LicenseRef-Nordic-5-Clause
 */

#include <zephyr.h>
#include <logging/log.h>

LOG_MODULE_REGISTER(cli_sample, CONFIG_OT_COMMAND_LINE_INTERFACE_LOG_LEVEL);

#define WELLCOME_TEXT                                                                              \
	"\n\r"                                                                                     \
	"\n\r"                                                                                     \
	"OpenThread Command Line Interface is now running.\n\r"                                    \
	"Use the 'ot' keyword to invoke OpenThread commands e.g. "                                 \
	"'ot thread start.'\n\r"                                                                   \
	"For the full commands list refer to the OpenThread CLI "                                  \
	"documentation at:\n\r"                                                                    \
	"https://github.com/openthread/openthread/blob/master/src/cli/README.md\n\r"

void main(void)
{
	LOG_INF(WELLCOME_TEXT);
}
```
